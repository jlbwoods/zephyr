## drivers/bluetooth/hci/Kconfig.cyw43439
```kconfig
# Copyright (c) 2026 Beechwoods Software
# SPDX-License-Identifier: Apache-2.0

config BT_CYW43439
	bool "Infineon CYW43439 Bluetooth HCI driver"
	default y
	depends on DT_HAS_INFINEON_CYW43439_BT_ENABLED
	depends on MFD_CYW43439
	depends on BT_HCI
	select BT_HCI_RAW
	help
	  Bluetooth HCI driver for Infineon CYW43439 chip.
	  Used on Raspberry Pi Pico W and Pico 2 W boards.
```

## drivers/led/Kconfig.cyw43439
```kconfig
# Copyright (c) 2026 Beechwoods Software
# SPDX-License-Identifier: Apache-2.0

config LED_CYW43439
	bool "CYW43439 LED driver"
	depends on MFD_CYW43439
	help
	  Enable LED driver for CYW43439 GPIO-controlled LEDs.
	  Used for onboard LED on Pico W and Pico 2 W.
```

## drivers/mfd/Kconfig.cyw43439
```kconfig
# Copyright (c) 2026 Beechwoods Software
# SPDX-License-Identifier: Apache-2.0

config MFD_CYW43439
	bool "Infineon CYW43439 WiFi/BT MFD driver"
	depends on SPI
	help
	  Enable MFD driver for Infineon CYW43439 WiFi/Bluetooth chip.
	  This chip is used on Raspberry Pi Pico W and Pico 2 W boards.
```

## dts/bindings/bluetooth/infineon,cyw43439-bt.yaml
```yaml
# Copyright (c) 2026 Beechwoods Software
# SPDX-License-Identifier: Apache-2.0

description: CYW43439 Bluetooth child device

compatible: "infineon,cyw43439-bt"

properties:
  status:
    type: string
    description: Device status (okay/disabled)
```

## dts/bindings/led/infineon,cyw43439-led.yaml
```yaml
# Copyright (c) 2026 Beechwoods Software
# SPDX-License-Identifier: Apache-2.0

description: CYW43439 GPIO LED

compatible: "infineon,cyw43439-led"

properties:
  gpios:
    type: int
    required: true
    description: CYW43439 GPIO pin number (0-2)
```

## dts/bindings/mfd/infineon,cyw43439.yaml
```yaml
# Copyright (c) 2026 Beechwoods Software
# SPDX-License-Identifier: Apache-2.0

description: Infineon CYW43439 WiFi/Bluetooth MFD

compatible: "infineon,cyw43439"

include: [spi-device.yaml, pinctrl-device.yaml]

bus: cyw43439

properties:
  wifi-reg-on-gpios:
    type: phandle-array
    description: GPIO to control chip power (WL_REG_ON)

  wifi-host-wake-gpios:
    type: phandle-array
    description: GPIO for host wake interrupt

  bus-select-gpios:
    type: phandle-array
    description: GPIO for bus selection (shared with data IRQ)
```

## dts/bindings/wifi/infineon,cyw43439-wifi.yaml
```yaml
# Copyright (c) 2026 Beechwoods Software
# SPDX-License-Identifier: Apache-2.0

description: CYW43439 WiFi child device (MFD-aware)

compatible: "infineon,cyw43439-wifi"

on-bus: cyw43439
```
